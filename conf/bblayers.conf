## conf/bblayers.conf
```bitbake
# POKY_BBLAYERS_CONF_VERSION is increased each time build/conf/bblayers.conf
# changes incompatibly
POKY_BBLAYERS_CONF_VERSION = "2"

BBPATH = "${TOPDIR}"
BBFILES ?= ""

BBLAYERS ?= " \
  /home/test/workspace/yocto/sources/poky/meta \
  /home/test/workspace/yocto/sources/poky/meta-poky \
  /home/test/workspace/yocto/sources/poky/meta-yocto-bsp \
  "
```
